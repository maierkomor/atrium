## main/Kconfig
```kconfig
menu "Atrium"

menu "software services"

config WFC_TARGET
	string "WFC target name"
	default ""
	help
		name of WFC configuration target

config VERIFY_HEAP
	bool "verify heap"
	depends on IDF_TARGET_ESP32

config APP_PARAMS
	bool "application specific parameters"
	default false
	help
		enable to add application parameters as key/value pairs in Config.app_params

config LUA
	depends on !IDF_TARGET_ESP8266
	bool "support Lua scripts processing"
	default true
	help
		Lua language and scripting support

config THRESHOLDS
	bool "support high/low schmitt-trigger thresholds on float variables"
	default true
	help
		support high/low schmitt-trigger thresholds on float variables, that trigger associated events

config UART_CONSOLE
	bool "serial console to configure and operate target device"
	default true
	help
		serial console is especially helpful for devices under development

config UART_MONITOR
	bool "serial monitor"
	depends on SYSLOG
	depends on TERM_SERV
	default true
	help
		serial monitor that forwards input data to syslog

config INTEGRATED_HELP
	bool "integrate help in app binary"
	default true
	help
		Integrate help texts into application binary. If you disable this option
		the help pages can still be provided in a ROMFS partition.

config HWCONF_DYNAMIC
	bool "online hardware configuration"
	default	true
	help
		support for configuring and modifying driver online

config UDNS
	bool "uDNS"
	default true
	help
		integrated micro DNS and MDNS implementation (requires patch for ESP-IDF, which is applied via setupenv.sh)

config MQTT
	bool "MQTT"
	default true
	help
		MQTT support

config AT_ACTIONS
	bool "at service"
	default true
	help
		support for triggering actions at predefined times

config HOLIDAYS
	depends on AT_ACTIONS
	bool "holidays"
	default true
	help
		holiday database for time triggered actions

config HTTP
	bool "http"
	default true
	help
		http server

config FTP
	depends on SPIFFS || FATFS
	bool "ftp"
	default false
	help
		ftp server

config TELNET
	bool "telnet"
	default true
	help
		telnet server

config TERMSERV
	bool "uart terminal server"
	default false
	help
		UART terminal server function

config SYSLOG
	bool "syslog"
	default true
	help
		send log messages to syslog host

config INFLUX
	bool "influx"
	default true
	help
		Support for sending measurements as UDP packets to Influx DB 

config OTA
	bool "ota"
	default true
	help
		over-the-air update support

config SMARTCONFIG
	bool "SmartConfig"
	default false
	help
		WiFi configuration with EPS smart config

config STATEMACHINES
	bool "state machines"
	default false
	help
		state-machine based event/action triggering

config UDPCTRL
	bool "UDP control port"
	default false
	help
		listen on UDP port for control commands

config WPS
	bool "wps"
	default false
	help
		WiFi auto-configuration with WPS

endmenu	# software services

menu "filesystem support"

config SPIFFS
	bool "SPIFFS"
	depends on USING_SPIFFS
	default false
	help
		SPI Flash File-System
config FATFS
	depends on IDF_TARGET_ESP32 || IDF_TARGET_ESP32S2 || IDF_TARGET_ESP32S3 || IDF_TARGET_ESP32C3
	bool "fatfs"
	default false
	help
		FAT file-system
config ROMFS
	bool "romfs"
	default true
	help
		ROM file-system

config ROMFS_VFS
	bool "romfs on VFS"
	depends on ROMFS
	default true
	help
		mount ROM file-system into VFS under its partition name

config ROMFS_VFS_NUMFDS
	int "number of file-descriptors"
	depends on ROMFS_VFS
	default 4
	help
		maximum number of parallel open files

config USB_HOST_FS
	bool "USB host filesystem via openocd"
	default false
	depends on DEVEL && (IDF_TARGET_ESP32S2 || IDF_TARGET_ESP32S3 || IDF_TARGET_ESP32C3)
	help
		"mount openocd host filesystem to /usb"
endmenu # filesystem

menu "hardware support"

config USB_DIAGLOG
	depends on CONFIG_ESP_CONSOLE_USB_SERIAL_JTAG || CONFIG_TINYUSB_CDC_ENABLED
	bool "diag output to USB serial"
	default true
	help
		output diagnostic log to USB serial connections

config USB_CONSOLE
	depends on CONFIG_ESP_CONSOLE_USB_SERIAL_JTAG || CONFIG_TINYUSB_CDC_ENABLED
	bool "diag output to USB serial"
	default true
	help
		output diagnostic log to USB serial connections

config IOEXTENDERS
	bool "I/O extenders"
	default true
	help
		enable infrastructure for I/O extenders

config LEDS
	bool "LEDs support with heartbeat/status logic"
	default true
	help
		heartbeat/status LEDs and different blinking schemes

config BUTTON
	bool	"button support"
	default true
	help
		support buttons and switches

config ROTARYENCODER
	bool	"rotary encoder"
	default true
	depends on BUTTON
	help
		support rotary encoders

config RELAY
	bool "relay"
	default true
	help
		relay attached to a GPIO

config ONEWIRE
	depends on !ESPTOOLPY_FLASHSIZE_1MB
	bool "onewire"
	default true
	help
		1-wire driver support (right now only DS18x20)

config TOUCHPAD
	depends on IDF_TARGET_ESP32 || IDF_TARGET_ESP32S2
	bool	"touchpad"
	default true
	help
		multi-channel touchpad support

config DISPLAY
	depends on !ESPTOOLPY_FLASHSIZE_1MB
	bool	"multi-purpose display support"
	default false
	help
		Support for displaying of time/date, and sensor data

config MAX7219
	depends on DISPLAY
	bool "MAX7219 driver"
	default true
	help
		"4-6 digit 7-segment display"

config HT16K33
	depends on DISPLAY && I2C_XDEV
	bool "HT16K33 driver"
	help
		"4-8 digit for 7/14-segment displays"

config SSD1306
	depends on DISPLAY && I2C_XDEV
	bool "SSD1306 driver"
	help
		"OLED displays based on SSD1306"

config DHT
	bool "DHT-xx sensor"
	default false
	help
		temperature/humidity measurement with a DHT-xx sensor

config HLW8012
	bool	"HLW8012"
	depends on DEVEL
	default false
	help
		HLW8012 power/voltage/current monitor

config I2C
	bool "I2C bus"
	default false
	help
		I2C bus infrastructure

config I2C_XCMD
	bool "extended command support for I2C devices"
	depends on I2C
	default true
	help
		provide extended commands for configuring I2C devices

config I2C_XDEV
	bool "explicit I2C device configuration"
	depends on I2C
	default true
	help
		support for configuring devices that cannot be detected automatically

config PCA9685
	depends on I2C_XDEV
	bool "pca9685"
	default true
	help
		16 channel, 12bit PWM I2C driver

config PCF8574
	depends on I2C_XDEV
	bool "pcf8574"
	default true
	help
		I2C driver for PCF8574 (GPIO expander), used as bridge for HD44780U

config TCA9555
	depends on I2C_XDEV && DEVEL
	bool "tca9555"
	default true
	help
		I2C driver for TCA9555 (GPIO expander)

config MCP2300X
	depends on I2C_XDEV
	bool "mcp2300x"
	default true
	help
		I2C driver for MCP2300x devices (8-port GPIO expander)

config MCP2301X
	depends on I2C_XDEV
	bool "mcp2301x"
	default true
	help
		I2C driver for MCP2301x devices (16-port GPIO expander)

config INA2XX
	bool "ina219"
	depends on I2C_XDEV
	default true
	help
		I2C driver for INA219 (current/voltage sensor)

config SI7021
	depends on I2C_XDEV
	bool "SI7021"
	default true
	help
		I2C driver for HTU21/SI7021/SI7020/SI7013 (temperature,humidity)

config BMX280
	depends on I2C
	bool "BMx280"
	default false
	help
		I2C driver for BME280 and BMP280 air sensor (temperature, humidity, pressure)

config BME680
	depends on I2C
	bool "BME680"
	default false
	help
		I2C driver for BME680 air sensor (temperature, humidity, pressure, electric resistance)

config HDC1000
	depends on I2C
	bool "HDC1000"
	default true
	help
		I2C driver for HDC1000 sensor (temperature,humidity)

config APDS9930
	depends on I2C
	bool "APDS9930"
	default true
	help
		I2C driver for APDS-9930 sensor (lux,proximity)

config SGP30
	depends on I2C
	bool "SGP30"
	default false
	help
		I2C driver for SGP30 sensor (TVOC,CO2)

config CCS811B
	depends on I2C
	bool "CCS811B"
	default true
	help
		I2C driver for CCS811B sensor (TVOC,CO2)

config BH1750
	bool "bh1750"
	depends on I2C
	default true
	help
		I2C driver for BH1750 (illuminance sensor)

config SPI
	bool "SPI"
	depends on IDF_TARGET_ESP32 || IDF_TARGET_ESP32S2
	default false
	help
		SPI driver infrastructure

config SX1276
	bool "SX1276"
	depends on DEVEL
	default false
	depends on SPI
	help
		dirver for SPI attached SX1276

config SSD1309
	bool "SSD1309"
	default false
	depends on SPI
	help
		dirver for 4-wire SPI attached SSD1309 display

config HCSR04
	bool "HC-SR04"
	default false
	help
		distance measurement with HC-SR04

config DIMMER
	bool "multi channel PWM dimmer support"
	default false
	help
		multi-channel PWM dimmer (esp32: hardware, esp8266: software)

config RGBLEDS
	bool	"RGB-LED array support"
	default false
	help
		LED array based on WS8212b

config CAMERA
	depends on IDF_TARGET_ESP32
	bool	"ESP32 camera support"
	default false

config TLC5947 
	bool	"TLC5947 based led control"
	default false

endmenu # harware support



menu "development tools and experimental/alpha drivers (disable all)"

config DEVEL
	bool "drivers under development"
	default false
	help
		show drivers under development

config FUNCTION_TIMING
	bool "instrument for performance analysis"
	default false
	help
		enable for performance analysis only - negative impact for general use

config SOCKET_API
	bool "socket API"
	default false
	help
		Use LWIP supplied socket API instead of native LwIP binding.
		Do not enable, unless you exactly know why.

endmenu # experimental stuff

endmenu
```
